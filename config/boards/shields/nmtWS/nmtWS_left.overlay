#include "nmtWS.dtsi" // Notice that the main dtsi files are included in the overlay.

&kscan0 {
    col-gpios
        = <&pro_micro 18 GPIO_ACTIVE_HIGH> // Col 1 in the schematic
        , <&pro_micro 15 GPIO_ACTIVE_HIGH> // Col 2 in the schematic
        , <&pro_micro 14 GPIO_ACTIVE_HIGH> // Col 3 in the schematic
        , <&pro_micro 16 GPIO_ACTIVE_HIGH> // Col 4 in the schematic
        , <&pro_micro 10 GPIO_ACTIVE_HIGH> // Col 5 in the schematic
        ;
};
