## config/boards/shields/nmtWS/Kconfig.defconfig
```kconfig
if SHIELD_NMTWS_LEFT

config ZMK_KEYBOARD_NAME
    default "nmtWS"

config ZMK_SPLIT_ROLE_CENTRAL
    default y

endif

if SHIELD_NMTWS_LEFT || SHIELD_NMTWS_RIGHT

config ZMK_SPLIT
    default y

endif
```

## config/boards/shields/nmtWS/Kconfig.shield
```kconfig
config SHIELD_NMTWS_LEFT
    def_bool $(shields_list_contains,nmtWS_left)

config SHIELD_NMTWS_RIGHT
    def_bool $(shields_list_contains,nmtWS_right)
```
